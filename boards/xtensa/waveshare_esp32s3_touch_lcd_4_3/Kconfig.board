## boards/xtensa/waveshare_esp32s3_touch_lcd_4_3/Kconfig.board
```kconfig
# Copyright (c) 2024 Joel Guittet
# Copyright (c) 2024 Tim Sørensen
# SPDX-License-Identifier: Apache-2.0

config BOARD_WAVESHARE_ESP32S3_TOUCH_LCD_4_3
	bool "ESP32-S3-Touch-LCD-4.3 Board"
	depends on SOC_SERIES_ESP32S3

choice SOC_PART_NUMBER
	default SOC_ESP32S3_R2
endchoice
```

## boards/xtensa/waveshare_esp32s3_touch_lcd_4_3/Kconfig.defconfig
```kconfig
# Copyright (c) 2024 Joel Guittet
# Copyright (c) 2024 Tim Sørensen
# SPDX-License-Identifier: Apache-2.0

if BOARD_WAVESHARE_ESP32S3_TOUCH_LCD_4_3

config BOARD
	default "waveshare_esp32s3_touch_lcd_4_3"

config HEAP_MEM_POOL_SIZE
	int
	default 98304 if WIFI
	default 40960 if BT
	default 4096

choice BT_HCI_BUS_TYPE
	default BT_ESP32 if BT
endchoice

endif

config ENTROPY_GENERATOR
	default y

config KERNEL_MEM_POOL
	default y

config PWM
	default y if DISPLAY

config LV_COLOR_16_SWAP
	default y if LVGL
```

## boards/xtensa/waveshare_esp32s3_touch_lcd_4_3/waveshare_esp32s3_touch_lcd_4_3_defconfig
```kconfig
# Copyright (c) 2024 Joel Guittet
# Copyright (c) 2024 Tim Sørensen
# SPDX-License-Identifier: Apache-2.0

CONFIG_SOC_SERIES_ESP32S3=y
CONFIG_BOARD_WAVESHARE_ESP32S3_TOUCH_LCD_4_3=y
CONFIG_MAIN_STACK_SIZE=2048
CONFIG_GPIO=y
CONFIG_REGULATOR=y
CONFIG_CONSOLE=y
CONFIG_SERIAL=y
CONFIG_UART_CONSOLE=y
CONFIG_CLOCK_CONTROL=y
CONFIG_INPUT_CST816S_INTERRUPT=n
```
